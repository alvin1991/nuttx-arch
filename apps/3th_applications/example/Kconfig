## apps/3th_applications/example/acdc_power_example/Kconfig
```kconfig
#
# For a description of the syntax of this configuration file,
# see the file kconfig-language.txt in the NuttX tools repository.
#

config EXAMPLES_ACDC_POWER
	bool "ACDC power example"
	default n
	---help---
		Enable the ACDC power example

if EXAMPLES_ACDC_POWER

config EXAMPLES_ACDC_POWER_PRIORITY
	int "ACDC power example task priority"
	default 100

config EXAMPLES_ACDC_POWER_STACKSIZE
	int "ACDC power example stack size"
	default 1024

endif
```

## apps/3th_applications/example/adis16488a_example/Kconfig
```kconfig
#
# For a description of the syntax of this configuration file,
# see the file kconfig-language.txt in the NuttX tools repository.
#

config MYPROJECT_EXAMPLE_ADIS16488A
	bool "adis16488a example"
	default n
	---help---
		Enable the \"adis16488a example\" project

if MYPROJECT_EXAMPLE_ADIS16488A

config MYPROJECT_EXAMPLE_ADIS16488A_PROGNAME
	string "adis16488a example"
	default "adis16488a example"
	depends on BUILD_KERNEL
	---help---
		This is the name of the program that will be use when the NSH ELF
		program is installed.

config MYPROJECT_EXAMPLE_ADIS16488A_PRIORITY
	int "adis16488a example priority"
	default 100

config MYPROJECT_EXAMPLE_ADIS16488A_STACKSIZE
	int "adis16488a example stack size"
	default 2048

endif
```

## apps/3th_applications/example/dac60096_example/Kconfig
```kconfig
#
# For a description of the syntax of this configuration file,
# see the file kconfig-language.txt in the NuttX tools repository.
#

config MYPROJECT_EXAMPLE_DAC60096
	bool "dac60096 example"
	default n
	---help---
		Enable the \"dac60096 example\" project

if MYPROJECT_EXAMPLE_DAC60096

config MYPROJECT_EXAMPLE_DAC60096_PROGNAME
	string "dac60096 example"
	default "dac60096 example"
	depends on BUILD_KERNEL
	---help---
		This is the name of the program that will be use when the NSH ELF
		program is installed.

config MYPROJECT_EXAMPLE_DAC60096_PRIORITY
	int "dac60096 example priority"
	default 100

config MYPROJECT_EXAMPLE_DAC60096_STACKSIZE
	int "dac60096 example stack size"
	default 2048

endif
```

## apps/3th_applications/uavcan_service/Kconfig
```kconfig
#
# For a description of the syntax of this configuration file,
# see the file kconfig-language.txt in the NuttX tools repository.
#

config APP_UAVCAN_SERVICE
	bool "\"uavcan_service\" Application"
	default n
	---help---
		Enable the uavcan_service application

if APP_UAVCAN_SERVICE

menu "uavcan service"

config APP_UAVCAN_SERVICE_PROGNAME
	string "Program name"
	default "uavcan_service"
	---help---
		This is the name of the program that will be use when the NSH ELF
		program is installed.

config APP_UAVCAN_SERVICE_PRIORITY
	int "Task priority"
	default 100

config APP_UAVCAN_SERVICE_STACKSIZE
	int "Stack size"
	default 2048
	

config UAVCAN_NODE_RTK_GPS
	bool "RTK-GPS node"
	default 1
	---help---
		Enable the RTK-GPS node

if UAVCAN_NODE_RTK_GPS
config UAVCAN_NODE_RTK_GPS_VIA_UDP
	bool "repeated via udp"
	default 1
	---help---
		if yes,mavlink will repeat this message via udp.
endif #UAVCAN_NODE_RTK_GPS

config UAVCAN_NODE_IMU
	bool "IMU node"
	default 1
	---help---
		Enable the IMU node
		
if UAVCAN_NODE_IMU
config UAVCAN_NODE_IMU_VIA_UDP
	bool "repeated via udp"
	default 1
	---help---
		if yes,mavlink will repeat this message via udp.
endif #UAVCAN_NODE_IMU		
		
endmenu # uavcan service

endif
```

## apps/3th_applications/webservice/Kconfig
```kconfig
#
# For a description of the syntax of this configuration file,
# see the file kconfig-language.txt in the NuttX tools repository.
#

config APP_WEBSERVICE
	bool "\"webservice\" Application"
	default n
	---help---
		Enable the webservice application

if APP_WEBSERVICE

menu "web(http) service"

config APP_WEBSERVICE_PROGNAME
	string "Program name"
	default "webservice"
	---help---
		This is the name of the program that will be use when the NSH ELF
		program is installed.

config APP_WEBSERVICE_PRIORITY
	int "Task priority"
	default 100

config APP_WEBSERVICE_STACKSIZE
	int "Stack size"
	default 2048

endmenu # web(http) service

endif
```

## apps/examples/websocket/Kconfig
```kconfig
#
# For a description of the syntax of this configuration file,
# see the file kconfig-language.txt in the NuttX tools repository.
#

config EXAMPLES_WEBSOCKET
	tristate "uIP websocket server example"
	default n
	---help---
		Enable the uIP websocket server example
```
